## conf/distro/spinyos.conf
```bitbake
# SpinyOS Distribution Configuration
# Custom Embedded Linux Distribution for Raspberry Pi

require conf/distro/poky.conf

DISTRO = "spinyos"
DISTRO_NAME = "SpinyOS"
DISTRO_VERSION = "1.0"
DISTRO_CODENAME = "RaspberryPi4"

# SDK and toolchain branding
SDK_NAME = "${DISTRO}-${TCLIBC}-${SDKMACHINE}-${IMAGE_BASENAME}-${TUNE_PKGARCH}-${MACHINE}"
SDK_VERSION = "${DISTRO_VERSION}"

# Maintainer
MAINTAINER = "SpinyOS Team <support@spinyos.local>"

# Distro features - systemd based
DISTRO_FEATURES:append = " systemd"
DISTRO_FEATURES_BACKFILL_CONSIDERED += "sysvinit"
VIRTUAL-RUNTIME_init_manager = "systemd"
VIRTUAL-RUNTIME_initscripts = ""
VIRTUAL-RUNTIME_login_manager = "shadow-base"

# Target OS branding - This changes uname output
TARGET_VENDOR = "-spinyos"

# OS release file customization
OS_RELEASE_FIELDS:append = " BUILD_ID"
BUILD_ID = "${DISTRO_VERSION}"

# Preferred versions (if needed)
# PREFERRED_VERSION_linux-raspberrypi = "5.15%"

# Security flags
SECURITY_CFLAGS = "-fstack-protector-strong -D_FORTIFY_SOURCE=2 -Wformat -Wformat-security"
SECURITY_LDFLAGS = "-Wl,-z,relro,-z,now"

# Package management
PACKAGE_CLASSES = "package_ipk"

# Extra image features
EXTRA_IMAGE_FEATURES ?= "debug-tweaks ssh-server-openssh"

# Hostname default (can be overridden)
# Set to the project hostname requested by the user

# License management
LICENSE_FLAGS_ACCEPTED = ""

# ROS2 baseline (meta-ros)
ROS_DISTRO ?= "humble"
ROS_VERSION ?= "2"
ROS_PYTHON_VERSION ?= "3"
```
